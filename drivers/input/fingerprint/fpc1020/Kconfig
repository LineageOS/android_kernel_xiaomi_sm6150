## drivers/input/fingerprint/fpc1020/Kconfig
```kconfig
config FINGERPRINT_FPC1020
	tristate "fpc fpc1020 fingerprint driver support"
	help
	  say y here to enable fpc fingerprint driver support!
```

## drivers/input/touchscreen/ft8719_touch_f7b/Kconfig
```kconfig
#
# Focaltech Touchscreen driver configuration
#
config TOUCHSCREEN_FTS_F7B
        bool "Focaltech Touchscreen"
		depends on I2C
		default n
		help
		  Say Y here if you have Focaltech touch panel.
		  If unsure, say N.

config TOUCHSCREEN_FTS_F7B_DIRECTORY
    string "Focaltech ts directory name"
    default "ft8719_touch_f7b"
    depends on TOUCHSCREEN_FTS_F7B
```

## drivers/input/touchscreen/nvt_touch_f7b/Kconfig
```kconfig
#
# Novatek NT36xxx touchscreen driver configuration
#
config TOUCHSCREEN_NVT_F7B
	tristate "novatek touchscreens"
	help
	  Say Y here if you have a nvt touchscreen.
	  nvt controllers are multi touch controllers which can
	  report 5 touches at a time.

	  If unsure, say N.

	  To compile this driver as a module, choose M here: the
	  module will be called nvt.

config TOUCHSCREEN_NT36xxx
	bool "Novatek NT36xxx"
	help
	  Say Y here if you have a Novatek NT36xxx touchscreen connected
	  to your system.

	  If unsure, say N.
```

## techpack/audio/Kconfig
```kconfig
menu "Techpack audio options"

config SND_SOC_TAS2563
	tristate "SND_SOC_TAS2563"
config TAS2563_CODEC
	tristate "TAS2653_CODEC"
config TAS2563_MISC
	tristate "TAS2653_MISC"
config TAS2563_REGMAP
	tristate "TAS2653_REGMAP"
endmenu
```
