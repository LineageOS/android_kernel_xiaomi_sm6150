/*
 * Copyright (c) 2018, The Linux Foundation. All rights reserved.
 *
 * This program is free software; you can redistribute it and/or modify
 * it under the terms of the GNU General Public License version 2 and
 * only version 2 as published by the Free Software Foundation.
 *
 * This program is distributed in the hope that it will be useful,
 * but WITHOUT ANY WARRANTY; without even the implied warranty of
 * MERCHANTABILITY or FITNESS FOR A PARTICULAR PURPOSE.  See the
 * GNU General Public License for more details.
 */

&qupv3_se7_i2c {
    status = "ok";
    tfa98xx@34 {
        compatible = "nxp,tfa98xx";
        reset-gpio = <&tlmm 66 0>;
        irq-gpio = <&tlmm 93 0>;
        interrupt-parent = <&tlmm>;
        interrupts = <93 0>;
        interrupt-names = "smartpa_irq";
        pinctrl-names = "default", "sleep";
        pinctrl-0 = <&smartpa_int_active &smartpa_enable_active>;
        pinctrl-1 = <&smartpa_int_suspend &smartpa_enable_suspend>;
        reg = <0x34>;
        status = "ok";
    };
};

&wcd937x_codec {
    qcom,cdc-micbias2-mv = <2750>;
};
