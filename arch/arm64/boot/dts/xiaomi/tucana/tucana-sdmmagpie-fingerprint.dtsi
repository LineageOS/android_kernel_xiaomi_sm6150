/*
 * Copyright (C) 2020 The LineageOS Project
 *
 * this file is for attribution only of tucana
 * And public attribution of Xiaomi platforms (like F4 and so)
 */

&soc {
	fingerprint_goodix {
		compatible = "goodix,fingerprint";
		goodix,gpio-reset = <&tlmm 65 0x0>;
		goodix,gpio-irq = <&tlmm 69 0x0>;
		fp-gpio-pwr = <&tlmm 63 0>;
		status = "ok";
	};
	fingerprint_fpc {
		status = "ok";
		compatible = "fpc,fpc1020";
		interrupt-parent = <&tlmm>;
		interrupts = <69 0x0>;
		fpc,gpio_rst    = <&tlmm 65 0x0>;
		fpc,gpio_irq    = <&tlmm 69 0x0>;
		fpc,gpio_vdd1v2  = <&pm6150_gpios 2 0x0>;
		fpc,gpio_vdd1v8  = <&pm6150_gpios 1 0x0>;
		fpc,gpio_vdd2v8  = <&tlmm 63 0x0>;
		/* fpc,enable-on-boot; */
		/* fpc,enable-wakeup; */

		pinctrl-names = "fpc1020_reset_reset",
			"fpc1020_reset_active",
			"fpc1020_irq_active",
			"fpc1020_vdd1v2_default",
			"fpc1020_vdd1v8_default";

		pinctrl-0 = <&msm_gpio_65>;
		pinctrl-1 = <&msm_gpio_65_output_high>;
		pinctrl-2 = <&msm_gpio_69>;
		pinctrl-3 = <&pm6150_gpios_2>;
		pinctrl-4 = <&pm6150_gpios_1>;
	};
};
