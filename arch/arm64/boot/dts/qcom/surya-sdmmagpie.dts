/* Copyright (c) 2018, The Linux Foundation. All rights reserved.
 *
 * This program is free software; you can redistribute it and/or modify
 * it under the terms of the GNU General Public License version 2 and
 * only version 2 as published by the Free Software Foundation.
 *
 * This program is distributed in the hope that it will be useful,
 * but WITHOUT ANY WARRANTY; without even the implied warranty of
 * MERCHANTABILITY or FITNESS FOR A PARTICULAR PURPOSE.  See the
 * GNU General Public License for more details.
 */

/dts-v1/;

#include "sdmmagpie.dtsi"
#include "sdmmagpie-idp.dtsi"
#include "sdmmagpie-audio-overlay.dtsi"

#include "xiaomi/surya/surya-sdmmagpie-base.dtsi"
#include "xiaomi/surya/surya-sdmmagpie-idp-overlay-base.dtsi"

/ {
	model = "Qualcomm Technologies, Inc. SDMMAGPIE SoC";
	compatible = "qcom,sdmmagpie";
	qcom,pmic-name = "PM6150";
	qcom,board-id = <0 0>;
};

&ufshc_mem {
	spm-level = <3>;
	rpm-level = <3>;
};
