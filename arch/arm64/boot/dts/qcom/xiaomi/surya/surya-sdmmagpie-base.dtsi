#include "surya-sdmmagpie.dtsi"
#include "surya-sdmmagpie-qupv3.dtsi"
#include "surya-sdmmagpie-sde.dtsi"
#include "surya-sdmmagpie-camera.dtsi"
#include "surya-pm6150.dtsi"
#include "surya-pm6150l.dtsi"
#include "surya-sdmmagpie-pinctrl.dtsi"
#include "surya-sdmmagpie-regulator.dtsi"
#include "surya-sdmmagpie-camera.dtsi"
#include "surya-sdmmagpie-usb.dtsi"
#include "surya-sdmmagpie-thermal.dtsi"
#include "surya-sm6150-audio.dtsi"
#include "surya-msm-audio-lpass.dtsi"
